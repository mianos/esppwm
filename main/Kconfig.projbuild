## main/Kconfig.projbuild
```kconfig
menu "Web PWM Configuration"

#    osource "components/ESP32-MAX31865/Kconfig"


config BUTTON_PIN
    int "Button GPIO Pin"
    default 9  # Default to GPIO_NUM_9 for generic boards
    help
        Select the GPIO pin number used for the button.

endmenu
```
